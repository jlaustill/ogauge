/**
 * Generated by C-Next Transpiler from: gauge_trans.cnx
 * A safer C for embedded systems
 */

#include "display/gauge_trans.hpp"

#include <Arduino.h>
#include <lvgl.h>
#include "../data/signal_data.hpp"

#include <stdint.h>
#include <stdbool.h>

// ADR-044: Overflow helper functions
#include <limits.h>

static inline uint8_t cnx_clamp_add_u8(uint8_t a, uint32_t b) {
    if (b > (uint32_t)(UINT8_MAX - a)) return UINT8_MAX;
    uint8_t result;
    if (__builtin_add_overflow(a, (uint8_t)b, &result)) return UINT8_MAX;
    return result;
}

/* Scope: GaugeTrans */
static lv_obj_t* GaugeTrans_gear_val = NULL;
static lv_obj_t* GaugeTrans_temp_title = NULL;
static lv_obj_t* GaugeTrans_temp_val = NULL;
static lv_obj_t* GaugeTrans_tow_chip = NULL;
static lv_obj_t* GaugeTrans_svc_chip = NULL;
static lv_obj_t* GaugeTrans_warn_chip = NULL;
static lv_obj_t* GaugeTrans_boost_title = NULL;
static lv_obj_t* GaugeTrans_boost_val = NULL;
static lv_obj_t* GaugeTrans_turbo_val = NULL;
static uint8_t GaugeTrans_flash_ctr = 0;
static bool GaugeTrans_flash_on = false;

static uint8_t GaugeTrans_gear_char(uint8_t raw) {
    uint8_t result = static_cast<uint8_t>('0');
    if (raw == 0xFF) {
        result = static_cast<uint8_t>('-');
    }
    if (raw == 0xFE) {
        result = static_cast<uint8_t>('-');
    }
    if (raw < 0xFE) {
        int32_t g = ((raw) & 0xFFU);
        g = g - 125;
        if (g >= 1 && g <= 9) {
            int32_t cv = 48 + g;
            result = static_cast<uint8_t>(((cv) & 0xFFU));
        }
        if (g <= -1 && g >= -9) {
            result = static_cast<uint8_t>('R');
        }
    }
    return result;
}

static uint8_t GaugeTrans_lever_char(uint8_t raw) {
    uint8_t result = raw;
    if (raw <= 0x20) {
        result = static_cast<uint8_t>('-');
    }
    if (raw == 0x36) {
        result = static_cast<uint8_t>('D');
    }
    return result;
}

static bool GaugeTrans_chip_lit(uint8_t state) {
    bool lit = false;
    if (state == 1) {
        lit = true;
    }
    if (state == 2) {
        lit = GaugeTrans_flash_on;
    }
    return lit;
}

static uint8_t GaugeTrans_warn_level(int32_t value, int32_t warn_at, int32_t crit_at) {
    uint8_t level = 0U;
    if (value >= warn_at) {
        level = 1U;
    }
    if (value >= crit_at) {
        level = 2U;
    }
    return level;
}

void GaugeTrans_update(void) {
    uint32_t now = millis();
    GaugeTrans_flash_ctr = cnx_clamp_add_u8(GaugeTrans_flash_ctr, 1U);
    if (GaugeTrans_flash_ctr >= 5) {
        GaugeTrans_flash_ctr = 0U;
    }
    GaugeTrans_flash_on = false;
    if (GaugeTrans_flash_ctr < 3) {
        GaugeTrans_flash_on = true;
    }
    bool blink = GaugeTrans_flash_on;
    uint32_t temp_age = now - SignalStore_current.trans_temp_c.time;
    uint32_t temp_color = 0xFFFFFFU;
    uint8_t temp_box = 0U;
    if (temp_age > SIGNAL_STALE_MS) {
        lv_label_set_text(GaugeTrans_temp_val, "---- C");
    } else {
        int32_t t = SignalStore_current.trans_temp_c.value;
        lv_label_set_text_fmt(GaugeTrans_temp_val, "%d C", t);
        uint8_t temp_level = GaugeTrans_warn_level(t, 120, 135);
        if (temp_level == 1) {
            temp_color = 0xFF8C00U;
            temp_box = 255U;
        }
        if (temp_level == 2) {
            temp_color = 0xFF3333U;
            temp_box = 0U;
            if (blink == true) {
                temp_box = 255U;
            }
        }
    }
    lv_obj_set_style_text_color(GaugeTrans_temp_val, lv_color_hex(temp_color), LV_PART_MAIN);
    lv_obj_set_style_border_color(GaugeTrans_temp_val, lv_color_hex(temp_color), LV_PART_MAIN);
    lv_obj_set_style_border_opa(GaugeTrans_temp_val, temp_box, LV_PART_MAIN);
    uint32_t boost_age = now - SignalStore_current.boost_kpa.time;
    if (boost_age > SIGNAL_STALE_MS) {
        lv_label_set_text(GaugeTrans_boost_val, "---- psi");
    } else {
        int32_t psi = SignalStore_current.boost_kpa.value * 0.145038;
        lv_label_set_text_fmt(GaugeTrans_boost_val, "%d psi", psi);
    }
    uint32_t turbo_age = now - SignalStore_current.turbo_mcu_temp_c.time;
    if (turbo_age > SIGNAL_STALE_MS) {
        lv_label_set_text(GaugeTrans_turbo_val, "TURBO -- C");
    } else {
        int32_t tt = SignalStore_current.turbo_mcu_temp_c.value;
        lv_label_set_text_fmt(GaugeTrans_turbo_val, "TURBO %d C", tt);
    }
    bool tow_lit = GaugeTrans_chip_lit(SignalStore_current.tow_haul.state);
    if (tow_lit == true) {
        lv_obj_set_style_text_color(GaugeTrans_tow_chip, lv_color_hex(0x4488FF), LV_PART_MAIN);
        lv_obj_set_style_border_color(GaugeTrans_tow_chip, lv_color_hex(0x4488FF), LV_PART_MAIN);
        lv_obj_set_style_border_opa(GaugeTrans_tow_chip, 255U, LV_PART_MAIN);
    } else {
        lv_obj_set_style_text_color(GaugeTrans_tow_chip, lv_color_hex(0xFFFFFF), LV_PART_MAIN);
        lv_obj_set_style_border_color(GaugeTrans_tow_chip, lv_color_hex(0x444444), LV_PART_MAIN);
        lv_obj_set_style_border_opa(GaugeTrans_tow_chip, 60U, LV_PART_MAIN);
    }
    bool svc_lit = GaugeTrans_chip_lit(SignalStore_current.trans_service.state);
    if (svc_lit == true) {
        lv_obj_set_style_text_color(GaugeTrans_svc_chip, lv_color_hex(0xFFAA00), LV_PART_MAIN);
        lv_obj_set_style_border_color(GaugeTrans_svc_chip, lv_color_hex(0xFFAA00), LV_PART_MAIN);
        lv_obj_set_style_border_opa(GaugeTrans_svc_chip, 255U, LV_PART_MAIN);
    } else {
        lv_obj_set_style_text_color(GaugeTrans_svc_chip, lv_color_hex(0xFFFFFF), LV_PART_MAIN);
        lv_obj_set_style_border_color(GaugeTrans_svc_chip, lv_color_hex(0x444444), LV_PART_MAIN);
        lv_obj_set_style_border_opa(GaugeTrans_svc_chip, 60U, LV_PART_MAIN);
    }
    bool warn_lit = GaugeTrans_chip_lit(SignalStore_current.trans_warning.state);
    if (warn_lit == true) {
        lv_obj_set_style_text_color(GaugeTrans_warn_chip, lv_color_hex(0xFF3333), LV_PART_MAIN);
        lv_obj_set_style_border_color(GaugeTrans_warn_chip, lv_color_hex(0xFF3333), LV_PART_MAIN);
        lv_obj_set_style_border_opa(GaugeTrans_warn_chip, 255U, LV_PART_MAIN);
    } else {
        lv_obj_set_style_text_color(GaugeTrans_warn_chip, lv_color_hex(0xFFFFFF), LV_PART_MAIN);
        lv_obj_set_style_border_color(GaugeTrans_warn_chip, lv_color_hex(0x444444), LV_PART_MAIN);
        lv_obj_set_style_border_opa(GaugeTrans_warn_chip, 60U, LV_PART_MAIN);
    }
    uint32_t age = now - SignalStore_current.gear.time;
    if (age > SIGNAL_STALE_MS) {
        lv_label_set_text(GaugeTrans_gear_val, "-  -  -");
    } else {
        uint8_t lv = GaugeTrans_lever_char(SignalStore_current.gear.lever);
        uint8_t dm = GaugeTrans_gear_char(SignalStore_current.gear.demanded);
        uint8_t ac = GaugeTrans_gear_char(SignalStore_current.gear.actual);
        lv_label_set_text_fmt(GaugeTrans_gear_val, "%c  %c  %c", lv, dm, ac);
    }
}

static void GaugeTrans_on_update_timer(lv_timer_t* t) {
    GaugeTrans_update();
}

void GaugeTrans_create(void) {
    lv_obj_t* scr = lv_screen_active();
    GaugeTrans_gear_val = lv_label_create(scr);
    lv_label_set_text(GaugeTrans_gear_val, "-  -  -");
    lv_obj_align(GaugeTrans_gear_val, LV_ALIGN_BOTTOM_MID, 0, -10);
    lv_obj_set_style_text_font(GaugeTrans_gear_val, &lv_font_montserrat_40, LV_PART_MAIN);
    lv_obj_set_style_text_color(GaugeTrans_gear_val, lv_color_hex(0xFFFFFF), LV_PART_MAIN);
    GaugeTrans_temp_title = lv_label_create(scr);
    lv_label_set_text(GaugeTrans_temp_title, "TRANS");
    lv_obj_align(GaugeTrans_temp_title, LV_ALIGN_LEFT_MID, 31, 38);
    lv_obj_set_style_text_font(GaugeTrans_temp_title, &lv_font_montserrat_32, LV_PART_MAIN);
    lv_obj_set_style_text_color(GaugeTrans_temp_title, lv_color_hex(0xFFFFFF), LV_PART_MAIN);
    GaugeTrans_temp_val = lv_label_create(scr);
    lv_label_set_text(GaugeTrans_temp_val, "---- C");
    lv_obj_align(GaugeTrans_temp_val, LV_ALIGN_LEFT_MID, 36, 81);
    lv_obj_set_style_text_font(GaugeTrans_temp_val, &lv_font_montserrat_40, LV_PART_MAIN);
    lv_obj_set_style_text_color(GaugeTrans_temp_val, lv_color_hex(0xFFFFFF), LV_PART_MAIN);
    lv_obj_set_style_border_width(GaugeTrans_temp_val, 3, LV_PART_MAIN);
    lv_obj_set_style_radius(GaugeTrans_temp_val, 6, LV_PART_MAIN);
    lv_obj_set_style_pad_left(GaugeTrans_temp_val, 6, LV_PART_MAIN);
    lv_obj_set_style_pad_right(GaugeTrans_temp_val, 6, LV_PART_MAIN);
    lv_obj_set_style_border_opa(GaugeTrans_temp_val, 0U, LV_PART_MAIN);
    GaugeTrans_boost_val = lv_label_create(scr);
    lv_label_set_text(GaugeTrans_boost_val, "---- psi");
    lv_obj_align(GaugeTrans_boost_val, LV_ALIGN_LEFT_MID, 41, -126);
    lv_obj_set_style_text_font(GaugeTrans_boost_val, &lv_font_montserrat_40, LV_PART_MAIN);
    lv_obj_set_style_text_color(GaugeTrans_boost_val, lv_color_hex(0xFFFFFF), LV_PART_MAIN);
    GaugeTrans_boost_title = lv_label_create(scr);
    lv_label_set_text(GaugeTrans_boost_title, "BOOST");
    lv_obj_align(GaugeTrans_boost_title, LV_ALIGN_LEFT_MID, 31, -83);
    lv_obj_set_style_text_font(GaugeTrans_boost_title, &lv_font_montserrat_32, LV_PART_MAIN);
    lv_obj_set_style_text_color(GaugeTrans_boost_title, lv_color_hex(0xFFFFFF), LV_PART_MAIN);
    GaugeTrans_turbo_val = lv_label_create(scr);
    lv_label_set_text(GaugeTrans_turbo_val, "TURBO -- C");
    lv_obj_align(GaugeTrans_turbo_val, LV_ALIGN_LEFT_MID, 60, -160);
    lv_obj_set_style_text_font(GaugeTrans_turbo_val, &lv_font_montserrat_14, LV_PART_MAIN);
    lv_obj_set_style_text_color(GaugeTrans_turbo_val, lv_color_hex(0xAAAAAA), LV_PART_MAIN);
    GaugeTrans_tow_chip = lv_label_create(scr);
    lv_label_set_text(GaugeTrans_tow_chip, "TOW");
    lv_obj_align(GaugeTrans_tow_chip, LV_ALIGN_LEFT_MID, 11, 0);
    lv_obj_set_style_text_font(GaugeTrans_tow_chip, &lv_font_montserrat_14, LV_PART_MAIN);
    lv_obj_set_style_border_width(GaugeTrans_tow_chip, 2, LV_PART_MAIN);
    lv_obj_set_style_radius(GaugeTrans_tow_chip, 4, LV_PART_MAIN);
    lv_obj_set_style_pad_all(GaugeTrans_tow_chip, 3, LV_PART_MAIN);
    lv_obj_set_style_text_color(GaugeTrans_tow_chip, lv_color_hex(0xFFFFFF), LV_PART_MAIN);
    lv_obj_set_style_border_color(GaugeTrans_tow_chip, lv_color_hex(0x444444), LV_PART_MAIN);
    lv_obj_set_style_border_opa(GaugeTrans_tow_chip, 60U, LV_PART_MAIN);
    GaugeTrans_svc_chip = lv_label_create(scr);
    lv_label_set_text(GaugeTrans_svc_chip, "SVC");
    lv_obj_align(GaugeTrans_svc_chip, LV_ALIGN_LEFT_MID, 11, -54);
    lv_obj_set_style_text_font(GaugeTrans_svc_chip, &lv_font_montserrat_14, LV_PART_MAIN);
    lv_obj_set_style_border_width(GaugeTrans_svc_chip, 2, LV_PART_MAIN);
    lv_obj_set_style_radius(GaugeTrans_svc_chip, 4, LV_PART_MAIN);
    lv_obj_set_style_pad_all(GaugeTrans_svc_chip, 3, LV_PART_MAIN);
    lv_obj_set_style_text_color(GaugeTrans_svc_chip, lv_color_hex(0xFFFFFF), LV_PART_MAIN);
    lv_obj_set_style_border_color(GaugeTrans_svc_chip, lv_color_hex(0x444444), LV_PART_MAIN);
    lv_obj_set_style_border_opa(GaugeTrans_svc_chip, 60U, LV_PART_MAIN);
    GaugeTrans_warn_chip = lv_label_create(scr);
    lv_label_set_text(GaugeTrans_warn_chip, "WARN");
    lv_obj_align(GaugeTrans_warn_chip, LV_ALIGN_LEFT_MID, 11, -27);
    lv_obj_set_style_text_font(GaugeTrans_warn_chip, &lv_font_montserrat_14, LV_PART_MAIN);
    lv_obj_set_style_border_width(GaugeTrans_warn_chip, 2, LV_PART_MAIN);
    lv_obj_set_style_radius(GaugeTrans_warn_chip, 4, LV_PART_MAIN);
    lv_obj_set_style_pad_all(GaugeTrans_warn_chip, 3, LV_PART_MAIN);
    lv_obj_set_style_text_color(GaugeTrans_warn_chip, lv_color_hex(0xFFFFFF), LV_PART_MAIN);
    lv_obj_set_style_border_color(GaugeTrans_warn_chip, lv_color_hex(0x444444), LV_PART_MAIN);
    lv_obj_set_style_border_opa(GaugeTrans_warn_chip, 60U, LV_PART_MAIN);
    lv_timer_create(GaugeTrans_on_update_timer, 100, 0);
}
