/**
 * Generated by C-Next Transpiler from: gauge_temp.cnx
 * A safer C for embedded systems
 */

#include "display/gauge_temp.hpp"

#include <Arduino.h>
#include <lvgl.h>
#include "../data/signal_data.hpp"

#include <stdint.h>

/* Scope: GaugeTemp */
static lv_obj_t* GaugeTemp_egt_title = NULL;
static lv_obj_t* GaugeTemp_egt_val = NULL;
static lv_obj_t* GaugeTemp_oil_title = NULL;
static lv_obj_t* GaugeTemp_oil_val = NULL;
static lv_obj_t* GaugeTemp_fuel_title = NULL;
static lv_obj_t* GaugeTemp_fuel_val = NULL;
static lv_obj_t* GaugeTemp_rpm_title = NULL;
static lv_obj_t* GaugeTemp_rpm_val = NULL;
static lv_obj_t* GaugeTemp_odo_title = NULL;
static lv_obj_t* GaugeTemp_odo_val = NULL;

void GaugeTemp_update(void) {
    uint32_t now = millis();
    uint32_t egt_age = now - SignalStore_current.egt_c.time;
    if (egt_age > SIGNAL_STALE_MS) {
        lv_label_set_text(GaugeTemp_egt_val, "---- C");
    } else {
        int32_t egt = SignalStore_current.egt_c.value;
        lv_label_set_text_fmt(GaugeTemp_egt_val, "%d C", egt);
    }
    uint32_t oil_age = now - SignalStore_current.oil_temp_c.time;
    if (oil_age > SIGNAL_STALE_MS) {
        lv_label_set_text(GaugeTemp_oil_val, "---- C");
    } else {
        int32_t oil = SignalStore_current.oil_temp_c.value;
        lv_label_set_text_fmt(GaugeTemp_oil_val, "%d C", oil);
    }
    uint32_t fuel_age = now - SignalStore_current.fuel_pressure_kpa.time;
    if (fuel_age > SIGNAL_STALE_MS) {
        lv_label_set_text(GaugeTemp_fuel_val, "---- kPa");
    } else {
        int32_t fuel = SignalStore_current.fuel_pressure_kpa.value;
        lv_label_set_text_fmt(GaugeTemp_fuel_val, "%d kPa", fuel);
    }
    uint32_t rpm_age = now - SignalStore_current.rpm.time;
    if (rpm_age > SIGNAL_STALE_MS) {
        lv_label_set_text(GaugeTemp_rpm_val, "---- RPM");
    } else {
        int32_t rpm = SignalStore_current.rpm.value;
        lv_label_set_text_fmt(GaugeTemp_rpm_val, "%d RPM", rpm);
    }
    uint32_t odo_age = now - SignalStore_current.total_dist_km.time;
    if (odo_age > SIGNAL_STALE_MS) {
        lv_label_set_text(GaugeTemp_odo_val, "---- mi");
    } else {
        int32_t odo = SignalStore_current.total_dist_km.value * 0.621371;
        lv_label_set_text_fmt(GaugeTemp_odo_val, "%d mi", odo);
    }
}

static void GaugeTemp_on_update_timer(lv_timer_t* t) {
    GaugeTemp_update();
}

void GaugeTemp_create(void) {
    lv_obj_t* scr = lv_screen_active();
    lv_obj_set_style_bg_color(scr, lv_color_hex(0x1A1A2E), LV_PART_MAIN);
    GaugeTemp_egt_title = lv_label_create(scr);
    lv_label_set_text(GaugeTemp_egt_title, "EGT");
    lv_obj_align(GaugeTemp_egt_title, LV_ALIGN_CENTER, 0, -142);
    lv_obj_set_style_text_font(GaugeTemp_egt_title, &lv_font_montserrat_14, LV_PART_MAIN);
    lv_obj_set_style_text_color(GaugeTemp_egt_title, lv_color_hex(0xFF8C00), LV_PART_MAIN);
    GaugeTemp_egt_val = lv_label_create(scr);
    lv_label_set_text(GaugeTemp_egt_val, "---- C");
    lv_obj_align(GaugeTemp_egt_val, LV_ALIGN_CENTER, 0, -116);
    lv_obj_set_style_text_font(GaugeTemp_egt_val, &lv_font_montserrat_32, LV_PART_MAIN);
    lv_obj_set_style_text_color(GaugeTemp_egt_val, lv_color_hex(0xFF8C00), LV_PART_MAIN);
    GaugeTemp_oil_title = lv_label_create(scr);
    lv_label_set_text(GaugeTemp_oil_title, "OIL");
    lv_obj_align(GaugeTemp_oil_title, LV_ALIGN_CENTER, 0, -78);
    lv_obj_set_style_text_font(GaugeTemp_oil_title, &lv_font_montserrat_14, LV_PART_MAIN);
    lv_obj_set_style_text_color(GaugeTemp_oil_title, lv_color_hex(0x4488FF), LV_PART_MAIN);
    GaugeTemp_oil_val = lv_label_create(scr);
    lv_label_set_text(GaugeTemp_oil_val, "---- C");
    lv_obj_align(GaugeTemp_oil_val, LV_ALIGN_CENTER, 0, -52);
    lv_obj_set_style_text_font(GaugeTemp_oil_val, &lv_font_montserrat_32, LV_PART_MAIN);
    lv_obj_set_style_text_color(GaugeTemp_oil_val, lv_color_hex(0x4488FF), LV_PART_MAIN);
    GaugeTemp_fuel_title = lv_label_create(scr);
    lv_label_set_text(GaugeTemp_fuel_title, "FUEL");
    lv_obj_align(GaugeTemp_fuel_title, LV_ALIGN_CENTER, 0, -14);
    lv_obj_set_style_text_font(GaugeTemp_fuel_title, &lv_font_montserrat_14, LV_PART_MAIN);
    lv_obj_set_style_text_color(GaugeTemp_fuel_title, lv_color_hex(0x44BB44), LV_PART_MAIN);
    GaugeTemp_fuel_val = lv_label_create(scr);
    lv_label_set_text(GaugeTemp_fuel_val, "---- kPa");
    lv_obj_align(GaugeTemp_fuel_val, LV_ALIGN_CENTER, 0, 12);
    lv_obj_set_style_text_font(GaugeTemp_fuel_val, &lv_font_montserrat_32, LV_PART_MAIN);
    lv_obj_set_style_text_color(GaugeTemp_fuel_val, lv_color_hex(0x44BB44), LV_PART_MAIN);
    GaugeTemp_rpm_title = lv_label_create(scr);
    lv_label_set_text(GaugeTemp_rpm_title, "RPM");
    lv_obj_align(GaugeTemp_rpm_title, LV_ALIGN_CENTER, 0, 50);
    lv_obj_set_style_text_font(GaugeTemp_rpm_title, &lv_font_montserrat_14, LV_PART_MAIN);
    lv_obj_set_style_text_color(GaugeTemp_rpm_title, lv_color_hex(0xFFFFFF), LV_PART_MAIN);
    GaugeTemp_rpm_val = lv_label_create(scr);
    lv_label_set_text(GaugeTemp_rpm_val, "---- RPM");
    lv_obj_align(GaugeTemp_rpm_val, LV_ALIGN_CENTER, 0, 76);
    lv_obj_set_style_text_font(GaugeTemp_rpm_val, &lv_font_montserrat_32, LV_PART_MAIN);
    lv_obj_set_style_text_color(GaugeTemp_rpm_val, lv_color_hex(0xFFFFFF), LV_PART_MAIN);
    GaugeTemp_odo_title = lv_label_create(scr);
    lv_label_set_text(GaugeTemp_odo_title, "ODO");
    lv_obj_align(GaugeTemp_odo_title, LV_ALIGN_CENTER, 0, 114);
    lv_obj_set_style_text_font(GaugeTemp_odo_title, &lv_font_montserrat_14, LV_PART_MAIN);
    lv_obj_set_style_text_color(GaugeTemp_odo_title, lv_color_hex(0xAAAAAA), LV_PART_MAIN);
    GaugeTemp_odo_val = lv_label_create(scr);
    lv_label_set_text(GaugeTemp_odo_val, "---- mi");
    lv_obj_align(GaugeTemp_odo_val, LV_ALIGN_CENTER, 0, 140);
    lv_obj_set_style_text_font(GaugeTemp_odo_val, &lv_font_montserrat_32, LV_PART_MAIN);
    lv_obj_set_style_text_color(GaugeTemp_odo_val, lv_color_hex(0xAAAAAA), LV_PART_MAIN);
    lv_timer_create(GaugeTemp_on_update_timer, 100, 0);
}
