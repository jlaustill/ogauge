/**
 * Generated by C-Next Transpiler from: can_bus.cnx
 * A safer C for embedded systems
 */

#include "data/can_bus.hpp"

#include <driver/twai.h>
#include <Arduino.h>
#include <J1939Message.hpp>
#include "j1939_decoder.hpp"

#include <stdint.h>
#include <stdbool.h>

/* Scope: CanBus */

void CanBus_init(void) {
    twai_general_config_t g_config = (twai_general_config_t){ .mode = TWAI_MODE_NORMAL, .tx_io = GPIO_NUM_19, .rx_io = GPIO_NUM_20, .clkout_io = TWAI_IO_UNUSED, .bus_off_io = TWAI_IO_UNUSED, .tx_queue_len = 0, .rx_queue_len = 32, .alerts_enabled = TWAI_ALERT_NONE, .clkout_divider = 0, .intr_flags = 0 };
    twai_timing_config_t t_config = (twai_timing_config_t){ .brp = 16, .tseg_1 = 15, .tseg_2 = 4, .sjw = 3, .triple_sampling = false };
    twai_filter_config_t f_config = (twai_filter_config_t){ .acceptance_code = 0, .acceptance_mask = 0xFFFFFFFF, .single_filter = true };
    esp_err_t err = twai_driver_install(&g_config, &t_config, &f_config);
    if (err != 0) {
        Serial.println("CAN: driver install FAILED");
        return;
    }
    err = twai_start();
    if (err != 0) {
        Serial.println("CAN: start FAILED");
        return;
    }
    Serial.println("CAN: started at 250kbps");
}

void CanBus_poll(void) {
    twai_message_t msg = {0};
    esp_err_t result = twai_receive(&msg, 0);
    while (result == ESP_OK) {
        J1939Message j_msg = {0};
        J1939_init(j_msg);
        J1939_setCanId(j_msg, msg.identifier);
        J1939_setData(j_msg, msg.data);
        uint16_t pgn = j_msg.pgn;
        Serial.printf("%08X#%02X%02X%02X%02X%02X%02X%02X%02X PGN=%d\n", msg.identifier, msg.data[0], msg.data[1], msg.data[2], msg.data[3], msg.data[4], msg.data[5], msg.data[6], msg.data[7], pgn);
        J1939Decoder_decode(pgn, msg.data);
        result = twai_receive(&msg, 0);
    }
}
