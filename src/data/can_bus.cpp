/**
 * Generated by C-Next Transpiler from: can_bus.cnx
 * A safer C for embedded systems
 */

#include "data/can_bus.hpp"

#include <driver/twai.h>
#include <Arduino.h>
#include <J1939Message.hpp>
#include "j1939_decoder.hpp"

#include <stdint.h>
#include <stdbool.h>

/* Scope: CanBus */
static uint32_t CanBus_last_req_ms = 0;

void CanBus_init(void) {
    twai_general_config_t g_config = { .mode = TWAI_MODE_NORMAL, .tx_io = GPIO_NUM_19, .rx_io = GPIO_NUM_20, .clkout_io = TWAI_IO_UNUSED, .bus_off_io = TWAI_IO_UNUSED, .tx_queue_len = 5, .rx_queue_len = 32, .alerts_enabled = TWAI_ALERT_NONE, .clkout_divider = 0, .intr_flags = 0 };
    twai_timing_config_t t_config = { .brp = 16, .tseg_1 = 15, .tseg_2 = 4, .sjw = 3, .triple_sampling = false };
    twai_filter_config_t f_config = { .acceptance_code = 0, .acceptance_mask = 0xFFFFFFFF, .single_filter = true };
    esp_err_t err = twai_driver_install(&g_config, &t_config, &f_config);
    if (err != 0) {
        Serial.println("CAN: driver install FAILED");
        return;
    }
    err = twai_start();
    if (err != 0) {
        Serial.println("CAN: start FAILED");
        return;
    }
    Serial.println("CAN: started at 250kbps");
}

static void CanBus_send_temp_request(void) {
    twai_message_t req = {};
    req.flags = 1;
    req.identifier = 0x18EA03F9;
    req.data_length_code = 8;
    req.data[0] = 0xF8;
    req.data[1] = 0xFE;
    req.data[2] = 0x00;
    req.data[3] = 0xFF;
    req.data[4] = 0xFF;
    req.data[5] = 0xFF;
    req.data[6] = 0xFF;
    req.data[7] = 0xFF;
    esp_err_t err = twai_transmit(&req, 0U);
    if (err != 0) {
        Serial.println("CAN TX: temp request failed");
    }
}

void CanBus_poll(void) {
    uint32_t now = millis();
    uint32_t since_req = now - CanBus_last_req_ms;
    if (since_req >= 1000) {
        CanBus_send_temp_request();
        CanBus_last_req_ms = now;
    }
    twai_message_t msg = {};
    esp_err_t result = twai_receive(&msg, 0U);
    while (result == ESP_OK) {
        J1939Message j_msg = {};
        J1939_init(j_msg);
        J1939_setCanId(j_msg, msg.identifier);
        J1939_setData(j_msg, msg.data);
        uint16_t pgn = j_msg.pgn;
        J1939Decoder_decode(pgn, j_msg.sourceAddress, msg.data);
        result = twai_receive(&msg, 0U);
    }
}
