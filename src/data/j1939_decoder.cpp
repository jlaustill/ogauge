/**
 * Generated by C-Next Transpiler from: j1939_decoder.cnx
 * A safer C for embedded systems
 */

#include "data/j1939_decoder.hpp"

#include <Arduino.h>
#include "signal_data.hpp"

#include <stdint.h>
#include <stdbool.h>

/* Scope: J1939Decoder */

static uint16_t J1939Decoder_extract_u16(const uint8_t data[8], uint8_t byte_lo, uint8_t byte_hi) {
    uint16_t raw = 0U;
    raw = (uint16_t)((raw & ~(0xFFU << 0)) | ((data[byte_lo] & 0xFFU) << 0));
    raw = (uint16_t)((raw & ~(0xFFU << 8)) | ((data[byte_hi] & 0xFFU) << 8));
    return raw;
}

static uint32_t J1939Decoder_extract_u32(const uint8_t data[8], uint8_t b0, uint8_t b1, uint8_t b2, uint8_t b3) {
    uint32_t raw = 0U;
    raw = (raw & ~(0xFFU << 0)) | ((data[b0] & 0xFFU) << 0);
    raw = (raw & ~(0xFFU << 8)) | ((data[b1] & 0xFFU) << 8);
    raw = (raw & ~(0xFFU << 16)) | ((data[b2] & 0xFFU) << 16);
    raw = (raw & ~(0xFFU << 24)) | ((data[b3] & 0xFFU) << 24);
    return raw;
}

static void J1939Decoder_decode_65269(const uint8_t data[8]) {
    uint8_t raw108 = data[0];
    SignalStore_current.barometric_pressure_kpa.value = raw108 * 0.5;
    SignalStore_current.barometric_pressure_kpa.time = millis();
    uint16_t raw171 = J1939Decoder_extract_u16(data, 3U, 4U);
    int32_t raw171_wide = ((raw171) & 0xFFFFU);
    SignalStore_current.ambient_temp_c.value = raw171_wide * 0.03125 - 273.0;
    SignalStore_current.ambient_temp_c.time = millis();
}

static void J1939Decoder_decode_65270(const uint8_t data[8]) {
    uint16_t raw173 = J1939Decoder_extract_u16(data, 4U, 5U);
    int32_t raw173_wide = ((raw173) & 0xFFFFU);
    SignalStore_current.egt_c.value = raw173_wide * 0.03125 - 273.0;
    SignalStore_current.egt_c.time = millis();
}

static void J1939Decoder_decode_65263(const uint8_t data[8]) {
    uint8_t raw94 = data[0];
    SignalStore_current.fuel_pressure_kpa.value = raw94 * 4.0;
    SignalStore_current.fuel_pressure_kpa.time = millis();
}

static void J1939Decoder_decode_65164(const uint8_t data[8]) {
    uint8_t raw354 = data[6];
    SignalStore_current.relative_humidity_pct.value = raw354 * 0.4;
    SignalStore_current.relative_humidity_pct.time = millis();
}

static void J1939Decoder_decode_65262(const uint8_t data[8]) {
    uint16_t raw175 = J1939Decoder_extract_u16(data, 2U, 3U);
    int32_t raw175_wide = ((raw175) & 0xFFFFU);
    SignalStore_current.oil_temp_c.value = raw175_wide * 0.03125 - 273.0;
    SignalStore_current.oil_temp_c.time = millis();
}

static void J1939Decoder_decode_61444(const uint8_t data[8]) {
    uint16_t raw190 = J1939Decoder_extract_u16(data, 3U, 4U);
    int32_t raw190_wide = ((raw190) & 0xFFFFU);
    SignalStore_current.rpm.value = raw190_wide * 0.125;
    SignalStore_current.rpm.time = millis();
}

static void J1939Decoder_decode_65248(const uint8_t data[8]) {
    uint32_t raw245 = J1939Decoder_extract_u32(data, 4U, 5U, 6U, 7U);
    if (raw245 != 0xFFFFFFFF) {
        SignalStore_current.total_dist_km.value = raw245 * 0.125;
        SignalStore_current.total_dist_km.time = millis();
    }
}

static void J1939Decoder_decode_61445(const uint8_t data[8]) {
    uint8_t lv = data[4];
    uint8_t dm = data[0];
    uint8_t ac = data[3];
    bool changed = false;
    if (lv != SignalStore_current.gear.lever) {
        changed = true;
    }
    if (dm != SignalStore_current.gear.demanded) {
        changed = true;
    }
    if (ac != SignalStore_current.gear.actual) {
        changed = true;
    }
    SignalStore_current.gear.lever = lv;
    SignalStore_current.gear.demanded = dm;
    SignalStore_current.gear.actual = ac;
    SignalStore_current.gear.time = millis();
    if (changed) {
        Serial.printf("GEAR: lever=%c(0x%02X) dmd=0x%02X cur=0x%02X\n", lv, lv, dm, ac);
    }
}

static void J1939Decoder_decode_65272(const uint8_t data[8]) {
    uint16_t raw177 = J1939Decoder_extract_u16(data, 4U, 5U);
    int32_t raw177_wide = ((raw177) & 0xFFFFU);
    float temp = raw177_wide * 0.03125 - 273.0;
    int32_t prev_i = SignalStore_current.trans_temp_c.value;
    int32_t new_i = static_cast<int32_t>(temp);
    SignalStore_current.trans_temp_c.value = temp;
    SignalStore_current.trans_temp_c.time = millis();
    if (new_i != prev_i) {
        Serial.printf("TRANS TEMP: %d C (raw=%d)\n", new_i, raw177_wide);
    }
}

static void J1939Decoder_decode_65098(const uint8_t data[8]) {
    uint8_t b_tow = data[2];
    uint8_t b_svc = data[0];
    uint8_t b_warn = data[5];
    uint8_t tow = static_cast<uint8_t>(((b_tow >> 4) & ((1U << 2) - 1)));
    uint8_t svc = static_cast<uint8_t>(((b_svc >> 2) & ((1U << 2) - 1)));
    uint8_t warn = static_cast<uint8_t>(((b_warn >> 2) & ((1U << 2) - 1)));
    bool changed = false;
    if (tow != SignalStore_current.tow_haul.state) {
        changed = true;
    }
    if (svc != SignalStore_current.trans_service.state) {
        changed = true;
    }
    if (warn != SignalStore_current.trans_warning.state) {
        changed = true;
    }
    uint32_t now = millis();
    SignalStore_current.tow_haul.state = tow;
    SignalStore_current.tow_haul.time = now;
    SignalStore_current.trans_service.state = svc;
    SignalStore_current.trans_service.time = now;
    SignalStore_current.trans_warning.state = warn;
    SignalStore_current.trans_warning.time = now;
    if (changed) {
        Serial.printf("ETC7: tow=%d svc=%d warn=%d (b3=0x%02X b1=0x%02X b6=0x%02X)\n", tow, svc, warn, b_tow, b_svc, b_warn);
    }
}

void J1939Decoder_decode(uint16_t pgn, uint8_t sa, const uint8_t data[8]) {
    if (pgn == 61444 && sa == 0) {
        J1939Decoder_decode_61444(data);
    }
    if (pgn == 65248 && sa == 0) {
        J1939Decoder_decode_65248(data);
    }
    if (pgn == 65270 && sa == 1) {
        J1939Decoder_decode_65270(data);
    }
    if (pgn == 65262 && sa == 1) {
        J1939Decoder_decode_65262(data);
    }
    if (pgn == 65263 && sa == 1) {
        J1939Decoder_decode_65263(data);
    }
    if (pgn == 65269 && sa == 1) {
        J1939Decoder_decode_65269(data);
    }
    if (pgn == 65164 && sa == 1) {
        J1939Decoder_decode_65164(data);
    }
    if (pgn == 61445 && sa == 3) {
        J1939Decoder_decode_61445(data);
    }
    if (pgn == 65272 && sa == 3) {
        J1939Decoder_decode_65272(data);
    }
    if (pgn == 65098 && sa == 3) {
        J1939Decoder_decode_65098(data);
    }
}
