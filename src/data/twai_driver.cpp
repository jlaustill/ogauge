/**
 * Generated by C-Next Transpiler from: twai_driver.cnx
 * A safer C for embedded systems
 */

#include "data/twai_driver.hpp"

#include <driver/twai.h>
#include <Arduino.h>
#include <J1939Message.hpp>

#include <stdint.h>
#include <stdbool.h>

/* Scope: TwaiDriver */
int32_t TwaiDriver_ambient_temp = -40;

void TwaiDriver_init(void) {
    twai_general_config_t g_config = (twai_general_config_t){ .mode = TWAI_MODE_NORMAL, .tx_io = GPIO_NUM_19, .rx_io = GPIO_NUM_20, .clkout_io = TWAI_IO_UNUSED, .bus_off_io = TWAI_IO_UNUSED, .tx_queue_len = 0, .rx_queue_len = 32, .alerts_enabled = TWAI_ALERT_NONE, .clkout_divider = 0, .intr_flags = 0 };
    twai_timing_config_t t_config = (twai_timing_config_t){ .brp = 16, .tseg_1 = 15, .tseg_2 = 4, .sjw = 3, .triple_sampling = false };
    twai_filter_config_t f_config = (twai_filter_config_t){ .acceptance_code = 0, .acceptance_mask = 0xFFFFFFFF, .single_filter = true };
    esp_err_t err = twai_driver_install(&g_config, &t_config, &f_config);
    if (err != 0) {
        Serial.println("TWAI: driver install FAILED");
        return;
    }
    err = twai_start();
    if (err != 0) {
        Serial.println("TWAI: start FAILED");
        return;
    }
    Serial.println("TWAI: started at 250kbps");
}

static void TwaiDriver_print_frame(const twai_message_t& msg) {
    uint32_t id = msg.identifier;
    Serial.print("can0  ");
    if (id < 0x10000000) {
        Serial.print("0");
    }
    if (id < 0x01000000) {
        Serial.print("0");
    }
    if (id < 0x00100000) {
        Serial.print("0");
    }
    if (id < 0x00010000) {
        Serial.print("0");
    }
    if (id < 0x00001000) {
        Serial.print("0");
    }
    if (id < 0x00000100) {
        Serial.print("0");
    }
    if (id < 0x00000010) {
        Serial.print("0");
    }
    Serial.print(id, 16);
    Serial.print("  [");
    Serial.print(msg.data_length_code);
    Serial.print("]  ");
    uint8_t i = 0U;
    while (i < msg.data_length_code) {
        if (msg.data[i] < 0x10) {
            Serial.print("0");
        }
        Serial.print(msg.data[i], 16);
        if (i < msg.data_length_code - 1) {
            Serial.print(" ");
        }
        i = i + 1U;
    }
    Serial.println("");
}

static void TwaiDriver_print_j1939(const J1939Message& j_msg) {
    uint16_t pgn = j_msg.pgn;
    Serial.print("  J1939  PGN:");
    Serial.print(pgn);
    Serial.print(" (0x");
    if (pgn < 0x1000) {
        Serial.print("0");
    }
    if (pgn < 0x0100) {
        Serial.print("0");
    }
    if (pgn < 0x0010) {
        Serial.print("0");
    }
    Serial.print(pgn, 16);
    Serial.print(")  SRC:0x");
    uint8_t src = j_msg.sourceAddress;
    if (src < 0x10) {
        Serial.print("0");
    }
    Serial.print(src, 16);
    Serial.print("  PRI:");
    Serial.println(j_msg.priority);
}

static void TwaiDriver_decode_spn171(const twai_message_t& msg) {
    uint8_t i = 3U;
    uint8_t byte3 = msg.data[i];
    i = 4U;
    uint8_t byte4 = msg.data[i];
    uint16_t raw = 0U;
    raw = (uint16_t)((raw & ~(0xFFU << 0)) | ((byte3 & 0xFFU) << 0));
    raw = (uint16_t)((raw & ~(0xFFU << 8)) | ((byte4 & 0xFFU) << 8));
    int32_t raw_wide = ((raw) & 0xFFFFU);
    TwaiDriver_ambient_temp = raw_wide / 32 - 273;
}

void TwaiDriver_poll(void) {
    twai_message_t msg = {0};
    esp_err_t result = twai_receive(&msg, 0);
    while (result == ESP_OK) {
        TwaiDriver_print_frame(msg);
        J1939Message j_msg = {0};
        J1939_init(j_msg);
        J1939_setCanId(j_msg, msg.identifier);
        J1939_setData(j_msg, msg.data);
        TwaiDriver_print_j1939(j_msg);
        uint16_t pgn = j_msg.pgn;
        if (pgn == 65269) {
            TwaiDriver_decode_spn171(msg);
        }
        result = twai_receive(&msg, 0);
    }
}
